//
//  Pocket SDR C Library - LDPC Decoding Functions
//
//  References:
//  [1] Software for Low Density Parity Check Codes
//      (https://shubhamchandak94.github.io/LDPC-codes)
//  [2] https://github.com/radfordneal/LDPC-codes
//  [3] IS-GPS-800E, NAVSTAR GPS Space Segment/Navigation User Segment
//      L1C Interfaces, March 4, 2019
//  [4] BeiDou Navigation Satellite System Signal In Space Interface Control
//      Document Open Service Signal B1C (Version 1.0), December, 2017
//  [5] BeiDou Navigation Satellite System Signal In Space Interface Control
//      Document Open Service Signal B2a (Version 1.0), December, 2017
//  [6] BeiDou Navigation Satellite System Signal In Space Interface Control
//      Document Open Service Signal B2b (Version 1.0), July, 2020
//  [7] NavIC Signal in Space ICD for Standard Positioning Service in L1
//      Frequency version 1.0, August, 2023
//
//  Author:
//  T.TAKASU
//
//  History:
//  2022-07-08  1.0  port sdr_ldpc.py to C
//  2023-01-07  1.1  support IRNV1_SF2 and IRNV1_SF3 in decode_LDPC()
//  2023-01-09  1.2  support BCNV1_SF2, BCNV1_SF3, BCNV2, BCNV3 in decode_LDPC()
//  2023-01-16  1.3  fix memory leak and unable decoding of LDPC
//
#include "pocket_sdr.h"

// constants -------------------------------------------------------------------
#define MAX_ITER  250
#define ERR_PROB  1e-5

// function prototypes of LDPC-codes ([1],[2]) ---------------------------------
extern int max_iter;
void *mod2sparse_allocate(int, int);
void *mod2sparse_insert(void *, int, int);
void mod2sparse_free(void *);
void prprp_decode_setup(void);
unsigned int prprp_decode(void *, double *, char *, char *, double *);
int check(void *, char *, char *);
double changed(double *, char *, int);

// global variables ------------------------------------------------------------
static const double RATIO[] = {
    (1.0 - ERR_PROB) / ERR_PROB, ERR_PROB / (1.0 - ERR_PROB)
};

// LDPC H-matrix cache ---------------------------------------------------------
static uint8_t *H_CNV2_SF2  = NULL;
static uint8_t *H_CNV2_SF3  = NULL;
static uint8_t *H_BCNV1_SF2 = NULL;
static uint8_t *H_BCNV1_SF3 = NULL;
static uint8_t *H_BCNV2     = NULL;
static uint8_t *H_BCNV3     = NULL;
static uint8_t *H_IRNV1_SF2 = NULL;
static uint8_t *H_IRNV1_SF3 = NULL;

// CNAV-2 LDPC H-matrix table ([3]) --------------------------------------------

static const uint16_t H_CNV2_SF2_A[][2] = { // [3] Table 6.2-2
    {  1,  1}, {  9, 17}, { 21, 33}, {432, 49}, {263, 65}, {534, 81}, {112, 97},
    {151,  1}, { 62, 17}, {228, 33}, {449, 49}, {366, 65}, {559, 81}, {196, 97},
    {440,  1}, {456, 17}, {299, 33}, {549, 49}, {402, 65}, {206, 82}, {102, 98},
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    {524,588}, {455,590}, {583,592}, { 32,595}, { 31,597}, { 91,599}
};

static const uint16_t H_CNV2_SF2_B[][2] = { // [3] Table 6.2-3
    {  1,  1}, {110,  1}, {178,  1}, {229,  1}, {269,  1}, {423,  1}, {532,  1},
    { 44,  1}, {155,  1}, {205,  1}, {263,  1}, {335,  1}, {510,  1}, {597,  1}
};

static const uint16_t H_CNV2_SF2_C[][2] = { // [3] Table 6.2-4
    {  1, 74}, {  1,322}, {  1,402}, {  1,485}, {  1,527}
};

static const uint16_t H_CNV2_SF2_D[][2] = { // [3] Table 6.2-5
    {  1,  1}
};

static const uint16_t H_CNV2_SF2_E[][2] = { // [3] Table 6.2-6
    {  1,598}, {  1,599}
};

static const uint16_t H_CNV2_SF2_T[][2] = { // [3] Table 6.2-7
    {  1,  1}, { 24, 24}, { 47, 46}, { 69, 69}, { 93, 92}, {116,116}, {140,140},
    {  2,  1}, { 25, 24}, { 47, 47}, { 70, 69}, { 93, 93}, {117,116}, {141,140},
    {  2,  2}, { 25, 25}, { 48, 47}, { 70, 70}, { 94, 93}, {117,117}, {141,141},
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    {507,507}, {522,522}, {538,537}, {553,553}, {569,568}, {584,584}
};

static const uint16_t H_CNV2_SF3_A[][2] = { // [3] Table 6.2-8
    {  1,  1}, { 41, 17}, {112, 33}, {142, 49}, {149, 65}, {219, 81}, {222, 97},
    { 17,  1}, {118, 17}, {179, 33}, {145, 49}, {216, 65}, {225, 81}, { 20, 98},
    {231,  1}, {161, 17}, { 74, 34}, { 36, 50}, { 61, 66}, { 15, 82}, {147, 98},
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    { 50,264}, {251,265}, {248,267}, {167,269}, {142,271}, { 60,273}
};

static const uint16_t H_CNV2_SF3_B[][2] = { // [3] Table 6.2-9
    {  3,  1}, { 71,  1}, {124,  1}, {155,  1}, {222,  1},
    { 20,  1}, { 76,  1}, {137,  1}, {195,  1}, {253,  1}
};

static const uint16_t H_CNV2_SF3_C[][2] = { // [3] Table 6.2-10
    {  1, 23}, {  1, 86}, {  1,177}, {  1,227}
};

static const uint16_t H_CNV2_SF3_D[][2] = { // [3] Table 6.2-11
    {  1,  1}
};

static const uint16_t H_CNV2_SF3_E[][2] = { // [3] Table 6.2-12
    {  1,271}, {  1,273}
};

static const uint16_t H_CNV2_SF3_T[][2] = { // [3] Table 6.2-13
    {  1,  1}, { 23, 23}, { 45, 45}, { 68, 68}, { 92, 90}, {113,112}, {135,135},
    {  2,  1}, { 24, 23}, { 46, 45}, { 69, 68}, { 91, 91}, {113,113}, {136,135},
    {  2,  2}, { 24, 24}, { 46, 46}, { 97, 68}, { 92, 91}, {114,113}, {136,136},
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    {175,175}, {191,191}, {207,207}, {224,224}, {240,240}, {257,257}
};

// B-CNAV1 LDPC H-matrix table ([4]) -------------------------------------------

static const uint8_t H_BCNV1_SF2_idx[][4] = { // [4] 6.2.2.2
    { 11, 62,102,150}, {  9, 60,100,148}, {  0, 51,142,197}, { 22, 80,116,154},
    {  4, 90,131,177}, { 47, 95,138,191}, { 51, 79,146,195}, { 44, 75,142,190},
    { 13, 57,135,198}, { 24, 65,120,173}, {  6, 88,129,179}, {  7, 89,130,176},
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    { 38, 88,136,184}, { 47, 74,141,189}, { 49, 77,144,193}, { 27, 92,110,181}
};

static const uint8_t H_BCNV1_SF2_ele[][4] = { // [4] 6.2.2.2
    { 35, 13, 51, 60}, {  1, 44, 53, 24}, {  1, 45, 15,  6}, { 45, 15,  6,  1},
    {  1, 44, 53, 24}, {  1, 45, 15,  6}, { 35, 46, 56, 15}, {  6,  1, 45, 15},
    { 15,  6,  1, 45}, { 44, 53, 24,  1}, { 24,  1, 44, 30}, {  1, 45, 15,  6},
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    { 24,  1, 44, 30}, { 24,  1, 44, 30}, {  1, 44, 53, 24}, { 53, 24,  1, 44}
};

static const uint8_t H_BCNV1_SF3_idx[][4] = { // [4] 6.2.2.3
    { 14, 35, 56, 70}, { 11, 29, 55, 73}, { 13, 39, 53, 69}, { 15, 34, 57, 71},
    {  1, 27, 45, 54}, { 23, 41, 63, 87}, {  2, 20, 46, 68}, {  6, 24, 50, 61},
    {  2, 26, 61, 79}, {  9, 33, 59, 77}, {  4, 30, 48, 74}, { 22, 42, 59, 76},
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    {  7, 25, 51, 60}, {  3, 27, 60, 78}, { 14, 32, 46, 78}, { 18, 20, 62, 65}
};

static const uint8_t H_BCNV1_SF3_ele[][4] = { // [4] 6.2.2.3
    { 30, 24,  1, 44}, { 24,  1, 44, 30}, { 40, 32, 61, 18}, { 53, 24,  1, 44},
    { 51, 60, 35, 13}, { 18, 15, 32, 61}, { 15,  6,  1, 45}, { 30, 24,  1, 44},
    {  6,  1, 45, 15}, { 45, 15,  6,  1}, {  1, 45, 15,  6}, {  1, 44, 53, 24},
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    { 45, 15,  6,  1}, {  1, 44, 30, 24}, {  6,  1, 45, 15}, {  1, 44, 53, 24}
};

// B-CNAV2 LDPC H-matrix table ([5]) -------------------------------------------

static const uint8_t H_BCNV2_idx[][4] = { // [5] 6.2.2
    { 19, 46, 49, 76}, {  5, 29, 53, 71}, { 17, 30, 64, 72}, { 22, 36, 59, 82},
    { 22, 41, 68, 94}, { 20, 44, 54, 75}, {  9, 41, 61, 86}, {  6, 47, 60, 89},
    {  8, 40, 60, 87}, { 15, 26, 66, 81}, { 19, 24, 67, 95}, {  2, 26, 50, 72},
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    {  4, 39, 71, 88}, { 13, 44, 68, 78}, {  3, 27, 51, 73}, { 10, 32, 58, 80}
};

static const uint8_t H_BCNV2_ele[][4] = { // [5] 6.2.2
    {  1, 45, 15,  6}, {  1, 44, 53, 24}, { 45, 15,  6,  1}, { 30, 24,  1, 44},
    { 18, 15, 32, 61}, {  3, 55,  9, 34}, { 35, 31, 50, 44}, { 45, 15,  6,  1},
    { 24,  1, 44, 53}, { 30, 24,  1, 44}, { 32, 42, 47, 37}, {  6,  1, 45, 15},
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    { 24,  1, 44, 30}, { 24,  1, 44, 30}, {  1, 44, 53, 24}, {  1, 44, 30, 24}
};

// B-CNAV3 LDPC H-matrix table ([6]) -------------------------------------------

static const uint8_t H_BCNV3_idx[][4] = { // [6] 6.2.2
    { 19, 67,109,130}, { 27, 71, 85,161}, { 31, 78, 96,122}, {  2, 44, 83,125},
    { 26, 71,104,132}, { 30, 39, 93,154}, {  4, 46, 85,127}, { 21, 62,111,127},
    { 13, 42,101,146}, { 18, 66,108,129}, { 27, 72,100,153}, { 29, 70, 84,160},
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    { 40, 67,118,152}, { 37, 79,108,149}, { 26, 59,118,137}
};

static const uint8_t H_BCNV3_ele[][4] = { // [6] 6.2.2
    { 46, 45, 44, 15}, { 15, 24, 50, 37}, { 24, 50, 37, 15}, { 15, 32, 18, 61},
    { 58, 56, 60, 62}, { 37, 53, 61, 29}, { 46, 58, 18,  6}, { 36, 19,  3, 57},
    { 54,  7, 38, 23}, { 51, 59, 63, 47}, {  9,  3, 43, 29}, { 56,  8, 46, 13},
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    { 19, 24, 42, 14}, {  1, 45, 15,  6}, {  8, 43, 27, 56}
};

// NavIC L1-SPS LDPC H-matrix table ([7]) --------------------------------------

static const uint16_t H_IRNV1_SF2_A [][2] = { // [7] table 30
    {  1,  1}, {232,  5}, {402,  9}, { 92, 14}, {294, 18}, {461, 22}, {121, 27},
    { 79,  1}, {281,  5}, {498,  9}, {108, 14}, {343, 18}, {547, 22}, {175, 27},
    {145,  1}, {330,  5}, {534,  9}, {162, 14}, {355, 18}, { 23, 23}, {204, 27},
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    {231,540}, {497,550}, { 11,561}, {210,571}, {464,581}, { 42,592}
};

static const uint16_t H_IRNV1_SF2_B[][2] = { // [7] table 31
    { 50,  1}, {308,  8}, { 15, 16}, {323, 23}, { 30, 31}, {338, 38}, { 45, 46},
    {301,  1}, {  8,  9}, {316, 16}, { 23, 24}, {331, 31}, { 38, 39}, {346, 46},
    {  1,  2}, {309,  9}, { 16, 17}, {324, 24}, { 31, 32}, {339, 39}, { 46, 47},
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    {  7,  8}, {315, 15}, { 22, 23}, {330, 30}, { 37, 38}, {345, 45}
};

static const uint16_t H_IRNV1_SF2_C[][2] = { // [7] table 32
    { 48,  1}, { 34, 37}, {  7,223}, {  7,359}, { 43,395}, {  6,431}, { 12,467},
    { 49,  2}, { 35, 38}, {  8,224}, {  8,360}, { 44,396}, {  7,432}, { 13,468},
    { 50,  3}, { 36, 39}, {  9,225}, {  9,361}, { 45,397}, {  8,433}, { 14,469},
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    { 33, 36}, {  6,222}, {  6,358}, { 42,394}, {  5,430}, { 11,466}
};

static const uint16_t H_IRNV1_SF2_D[][2] = { // [7] table 33
    { 50,  1}, {  8,  9}, { 16, 17}, { 24, 25}, { 32, 33}, { 40, 41}, { 48, 49},
    {  1,  2}, {  9, 10}, { 17, 18}, { 25, 26}, { 33, 34}, { 41, 42}, { 49, 50},
    {  2,  3}, { 10, 11}, { 18, 19}, { 26, 27}, { 34, 35}, { 42, 43},
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    {  7,  8}, { 15, 16}, { 23, 24}, { 31, 32}, { 39, 40}, { 47, 48}
};

static const uint16_t H_IRNV1_SF2_E[][2] = { // [7] table 34
    {  1,501}, {  9,509}, { 17,517}, { 25,525}, { 33,533}, { 41,541}, { 49,549},
    {  2,502}, { 10,510}, { 18,518}, { 26,526}, { 34,534}, { 42,542}, { 50,550},
    {  3,503}, { 11,511}, { 19,519}, { 27,527}, { 35,535}, { 43,543},
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    {  8,508}, { 16,516}, { 24,524}, { 32,532}, { 40,540}, { 48,548}
};

static const uint16_t H_IRNV1_SF2_T[][2] = { // [7] table 35
    {  1,  1}, { 25, 25}, { 49, 49}, { 73, 73}, { 97, 97}, {121,121}, {145,145},
    { 51,  1}, { 75, 25}, { 99, 49}, {123, 73}, {147, 97}, {171,121}, {195,145},
    {  2,  2}, { 26, 26}, { 50, 50}, { 74, 74}, { 98, 98}, {122,122}, {146,146},
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    {514,514}, {520,520}, {526,526}, {532,532}, {538,538}, {544,544}, {550,550}
};

static const uint16_t H_IRNV1_SF3_A[][2] = { // [7] table 36
    {  3,  1}, { 99,  5}, {188,  9}, { 40, 14}, {134, 18}, {169, 30}, {117, 46},
    { 27,  1}, {121,  5}, {207,  9}, { 56, 14}, {156, 18}, {196, 30}, {247, 46},
    { 66,  1}, {143,  5}, {239,  9}, { 83, 14}, {168, 18}, { 33, 31}, { 49, 47},
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    { 84,220}, { 49,231}, {215,239}, {103,248}, {219,257}, { 96,266}
};

static const uint16_t H_IRNV1_SF3_B[][2] = { // [7] table 37
    {139,  1}, {  4,  5}, {146,  8}, { 11, 12}, {153, 15}, { 18, 19}, { 23, 23},
    {  1,  2}, {143,  5}, {  8,  9}, {150, 12}, { 15, 16}, {157, 19},
    {140,  2}, {  5,  6}, {147,  9}, { 12, 13}, {154, 16}, { 19, 20},
    {  2,  3}, {144,  6}, {  9, 10}, {151, 13}, { 16, 17}, {158, 20},
    {141,  3}, {  6,  7}, {148, 10}, { 13, 14}, {155, 17}, { 20, 21},
    {  3,  4}, {145,  7}, { 10, 11}, {152, 14}, { 17, 18}, {159, 21},
    {142,  4}, {  7,  8}, {149, 11}, { 14, 15}, {156, 18}, { 22, 22}
};

static const uint16_t H_IRNV1_SF3_C[][2] = { // [7] table 38
    {  2,  1}, { 19, 18}, { 23,104}, {  8,167}, {  2,184}, { 19,201}, { 10,218},
    {  3,  2}, { 20, 19}, {  1,105}, {  9,168}, {  3,185}, { 20,202}, { 11,219},
    {  4,  3}, {  8, 89}, {  2,106}, { 10,169}, {  4,186}, { 21,203}, { 12,220},
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    { 18, 17}, { 22,103}, {  7,166}, {  1,183}, { 18,200}, {  9,217}
};

static const uint16_t H_IRNV1_SF3_D[][2] = { // [7] table 39
    { 21, 20}, { 22, 21}
};

static const uint16_t H_IRNV1_SF3_E[][2] = { // [7] table 40
    {  1,229}, {  5,233}, {  9,237}, { 13,241}, { 17,245}, { 21,249},
    {  2,230}, {  6,234}, { 10,238}, { 14,242}, { 18,246}, { 22,250},
    {  3,231}, {  7,235}, { 11,239}, { 15,243}, { 19,247}, { 23,251},
    {  4,232}, {  8,236}, { 12,240}, { 16,244}, { 20,248}
};

static const uint16_t H_IRNV1_SF3_T[][2] = { // [7] table 41
    {  1,  1}, { 25, 25}, { 49, 49}, { 73, 73}, { 97, 97}, {121,121}, {145,145},
    { 24,  1}, { 48, 25}, { 72, 49}, { 96, 73}, {120, 97}, {144,121}, {168,145},
    {  2,  2}, { 26, 26}, { 50, 50}, { 74, 74}, { 98, 98}, {122,122}, {146,146},
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    {179,179}, {212,189}, {200,200}, {233,210}, {221,221}, {234,234}
};

// generate binary LDPC parity check matrix ------------------------------------
static void *gen_B_LDPC_H(int m, int n, int g, const uint16_t H_A[][2],
    const uint16_t H_B[][2], const uint16_t H_C[][2], const uint16_t H_D[][2],
    const uint16_t H_E[][2], const uint16_t H_T[][2], int na, int nb, int nc,
    int nd, int ne, int nt)
{
    void *H = mod2sparse_allocate(m, n);
    
    for (int i = 0; i < na; i++) {
        mod2sparse_insert(H, H_A[i][0] - 1, H_A[i][1] - 1);
    }
    for (int i = 0; i < nb; i++) {
        mod2sparse_insert(H, H_B[i][0] - 1, m + H_B[i][1] - 1);
    }
    for (int i = 0; i < nc; i++) {
        mod2sparse_insert(H, m - g + H_C[i][0] - 1, H_C[i][1] - 1);
    }
    for (int i = 0; i < nd; i++) {
        mod2sparse_insert(H, m - g + H_D[i][0] - 1, m + H_D[i][1] - 1);
    }
    for (int i = 0; i < ne; i++) {
        mod2sparse_insert(H, m - g + H_E[i][0] - 1, m + g + H_E[i][1] - 1);
    }
    for (int i = 0; i < nt; i++) {
        mod2sparse_insert(H, H_T[i][0] - 1, m + g + H_T[i][1] - 1);
    }
    return H;
}

// free binary LDPC parity check matrix ----------------------------------------
static void free_B_LDPC_H(void *H)
{
    mod2sparse_free(H);
}

// decode binary LDPC ----------------------------------------------------------
static int decode_B_LDPC(void *H, int m, int n, const uint8_t *syms,
    uint8_t *syms_dec)
{
    double *lratio = (double *)sdr_malloc(sizeof(double) * n);
    char   *dblk   = (char   *)sdr_malloc(sizeof(char)   * n);
    char   *pchk   = (char   *)sdr_malloc(sizeof(char)   * n);
    double *bitpr  = (double *)sdr_malloc(sizeof(double) * n);
    
    for (int i = 0; i < n; i++) {
        lratio[i] = RATIO[syms[i]];
    }
    // setup decoder
    max_iter = MAX_ITER;
    prprp_decode_setup();
    
    // decode LDPC by probability propagation
    int niter = (int)prprp_decode(H, lratio, dblk, pchk, bitpr);
    int valid = check(H, dblk, pchk) == 0;
    int nerr = (int)changed(lratio, dblk, n);
    
    sdr_free(lratio);
    sdr_free(dblk);
    sdr_free(pchk);
    sdr_free(bitpr);
    return valid ? nerr : -1;
}

// decode LDPC(1200,600) of CNAV-2 subframe 2 ----------------------------------
static int decode_LDPC_CNV2_SF2(const uint8_t *syms, uint8_t *syms_dec)
{
    if (!H_CNV2_SF2) {
        int na = (int)sizeof(H_CNV2_SF2_A) / 4;
        int nb = (int)sizeof(H_CNV2_SF2_B) / 4;
        int nc = (int)sizeof(H_CNV2_SF2_C) / 4;
        int nd = (int)sizeof(H_CNV2_SF2_D) / 4;
        int ne = (int)sizeof(H_CNV2_SF2_E) / 4;
        int nt = (int)sizeof(H_CNV2_SF2_T) / 4;
        H_CNV2_SF2 = gen_B_LDPC_H(600, 1200, 1, H_CNV2_SF2_A, H_CNV2_SF2_B,
            H_CNV2_SF2_C, H_CNV2_SF2_D, H_CNV2_SF2_E, H_CNV2_SF2_T, na, nb, nc,
            nd, ne, nt);
    }
    return decode_B_LDPC(H_CNV2_SF2, 600, 1200, syms, syms_dec);
}

// decode LDPC(548,274) of CNAV-2 subframe 3 -----------------------------------
static int decode_LDPC_CNV2_SF3(const uint8_t *syms, uint8_t *syms_dec)
{
    if (!H_CNV2_SF3) {
        int na = (int)sizeof(H_CNV2_SF3_A) / 4;
        int nb = (int)sizeof(H_CNV2_SF3_B) / 4;
        int nc = (int)sizeof(H_CNV2_SF3_C) / 4;
        int nd = (int)sizeof(H_CNV2_SF3_D) / 4;
        int ne = (int)sizeof(H_CNV2_SF3_E) / 4;
        int nt = (int)sizeof(H_CNV2_SF3_T) / 4;
        H_CNV2_SF3 = gen_B_LDPC_H(274, 548, 1, H_CNV2_SF3_A, H_CNV2_SF3_B,
            H_CNV2_SF3_C, H_CNV2_SF3_D, H_CNV2_SF3_E, H_CNV2_SF3_T, na, nb, nc,
            nd, ne, nt);
    }
    return decode_B_LDPC(H_CNV2_SF3, 274, 548, syms, syms_dec);
}

// decode NB-LDPC(200,100) of B-CNAV1 subframe 2 -------------------------------
static int decode_LDPC_BCNV1_SF2(const uint8_t *syms, uint8_t *syms_dec)
{
    uint8_t syms_rev[1200];
    
    for (int i = 0; i < 1200; i++) {
        syms_rev[i] = syms[i] ^ (uint8_t)1;
    }
    return sdr_decode_NB_LDPC(H_BCNV1_SF2_idx, H_BCNV1_SF2_ele, 100, 200,
        syms_rev, syms_dec);
}

// decode NB-LDPC(88,44) of B-CNAV1 subframe 3 ---------------------------------
static int decode_LDPC_BCNV1_SF3(const uint8_t *syms, uint8_t *syms_dec)
{
    uint8_t syms_rev[528];
    
    for (int i = 0; i < 528; i++) {
        syms_rev[i] = syms[i] ^ (uint8_t)1;
    }
    return sdr_decode_NB_LDPC(H_BCNV1_SF3_idx, H_BCNV1_SF3_ele, 44, 88,
        syms_rev, syms_dec);
}

// decode NB-LDPC(96,48) of B-CNAV2 frame --------------------------------------
static int decode_LDPC_BCNV2(const uint8_t *syms, uint8_t *syms_dec)
{
    return sdr_decode_NB_LDPC(H_BCNV2_idx, H_BCNV2_ele, 48, 96, syms, syms_dec);
}

// decode NB-LDPC(162,81) of B-CNAV3 frame -------------------------------------
static int decode_LDPC_BCNV3(const uint8_t *syms, uint8_t *syms_dec)
{
    return sdr_decode_NB_LDPC(H_BCNV3_idx, H_BCNV3_ele, 81, 162, syms,
        syms_dec);
}

// decode LDPC(1200,600) of NavIC L1-SPS NAV subframe 2 ------------------------
static int decode_LDPC_IRNV1_SF2(const uint8_t *syms, uint8_t *syms_dec)
{
    if (!H_IRNV1_SF2) {
        int na = (int)sizeof(H_IRNV1_SF2_A) / 4;
        int nb = (int)sizeof(H_IRNV1_SF2_B) / 4;
        int nc = (int)sizeof(H_IRNV1_SF2_C) / 4;
        int nd = (int)sizeof(H_IRNV1_SF2_D) / 4;
        int ne = (int)sizeof(H_IRNV1_SF2_E) / 4;
        int nt = (int)sizeof(H_IRNV1_SF2_T) / 4;
        H_IRNV1_SF2 = gen_B_LDPC_H(600, 1200, 50, H_IRNV1_SF2_A, H_IRNV1_SF2_B,
            H_IRNV1_SF2_C, H_IRNV1_SF2_D, H_IRNV1_SF2_E, H_IRNV1_SF2_T, na, nb,
            nc, nd, ne, nt);
    }
    return decode_B_LDPC(H_IRNV1_SF2, 600, 1200, syms, syms_dec);
}

// decode LDPC(548,274) of NavIC L1-SPS NAV subframe 3 -------------------------
static int decode_LDPC_IRNV1_SF3(const uint8_t *syms, uint8_t *syms_dec)
{
    if (!H_IRNV1_SF3) {
        int na = (int)sizeof(H_IRNV1_SF3_A) / 4;
        int nb = (int)sizeof(H_IRNV1_SF3_B) / 4;
        int nc = (int)sizeof(H_IRNV1_SF3_C) / 4;
        int nd = (int)sizeof(H_IRNV1_SF3_D) / 4;
        int ne = (int)sizeof(H_IRNV1_SF3_E) / 4;
        int nt = (int)sizeof(H_IRNV1_SF3_T) / 4;
        H_IRNV1_SF3 = gen_B_LDPC_H(274, 548, 23, H_IRNV1_SF3_A, H_IRNV1_SF3_B,
            H_IRNV1_SF3_C, H_IRNV1_SF3_D, H_IRNV1_SF3_E, H_IRNV1_SF3_T, na, nb,
            nc, nd, ne, nt);
    }
    return decode_B_LDPC(H_IRNV1_SF3, 274, 548, syms, syms_dec);
}

// decode LDPC -----------------------------------------------------------------
int sdr_decode_LDPC(const char *type, const uint8_t *syms, int N,
    uint8_t *syms_dec)
{
    if (!strcmp(type, "CNV2_SF2")) {
        return decode_LDPC_CNV2_SF2(syms, syms_dec);
    }
    else if (!strcmp(type, "CNV2_SF3")) {
        return decode_LDPC_CNV2_SF3(syms, syms_dec);
    }
    else if (!strcmp(type, "BCNV1_SF2")) {
        return decode_LDPC_BCNV1_SF2(syms, syms_dec);
    }
    else if (!strcmp(type, "BCNV1_SF3")) {
        return decode_LDPC_BCNV1_SF3(syms, syms_dec);
    }
    else if (!strcmp(type, "BCNV2")) {
        return decode_LDPC_BCNV2(syms, syms_dec);
    }
    else if (!strcmp(type, "BCNV3")) {
        return decode_LDPC_BCNV3(syms, syms_dec);
    }
    else if (!strcmp(type, "IRNV1_SF2")) {
        return decode_LDPC_IRNV1_SF2(syms, syms_dec);
    }
    else if (!strcmp(type, "IRNV1_SF3")) {
        return decode_LDPC_IRNV1_SF3(syms, syms_dec);
    }
    return -1;
}

