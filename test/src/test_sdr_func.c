//
//  Unit tests for sdr_func.c.
//
#include "test_sdr.h"

#define TMP_DATA    "test_sdr_func_data.bin"
#define TMP_TAG     "test_sdr_func_tag.bin"
#define TMP_BAD_TAG "test_sdr_func_bad_tag.bin"
#define TMP_STREAM  "test_sdr_func_stream.txt"
#define TMP_LOG     "test_sdr_func_log.txt"
#define TMP_LOG2    "test_sdr_func_log2.txt"
#define TMP_WISDOM  "test_sdr_func_wisdom.txt"

// remove files generated by these tests ---------------------------------------
static void cleanup_files(void)
{
    remove(TMP_DATA);
    remove(TMP_TAG ".tag");
    remove(TMP_BAD_TAG ".tag");
    remove(TMP_STREAM);
    remove(TMP_LOG);
    remove(TMP_LOG2);
    remove(TMP_WISDOM);
}

// write binary test file ------------------------------------------------------
static void write_file(const char *path, const void *data, size_t size)
{
    FILE *fp = fopen(path, "wb");
    
    TEST_ASSERT_TRUE(fp != NULL);
    TEST_ASSERT_EQ_INT((int)size, (int)fwrite(data, 1, size, fp));
    fclose(fp);
}

// get file size ---------------------------------------------------------------
static long file_size(const char *path)
{
    FILE *fp = fopen(path, "rb");
    long size;
    
    TEST_ASSERT_TRUE(fp != NULL);
    fseek(fp, 0, SEEK_END);
    size = ftell(fp);
    fclose(fp);
    return size;
}

// pack signed I/Q values into sdr_cpx8_t --------------------------------------
static sdr_cpx8_t pack_cpx8(int re, int im)
{
    return (sdr_cpx8_t)((((uint8_t)im & 0x0F) << 4) | ((uint8_t)re & 0x0F));
}

// sdr_func_init() -------------------------------------------------------------
static void test_sdr_func_init_api(void)
{
    sdr_func_init("");
}

// sdr_cpx_malloc(), sdr_cpx_free(), sdr_cpx_abs(), sdr_cpx_mul(), sdr_cpx_fft()
static void test_sdr_cpx_api(void)
{
    sdr_cpx_t *a = sdr_cpx_malloc(4);
    sdr_cpx_t *b = sdr_cpx_malloc(4);
    sdr_cpx_t *c = sdr_cpx_malloc(4);
    sdr_cpx_t z = {3.0f, 4.0f};
    
    TEST_ASSERT_TRUE(a != NULL);
    TEST_ASSERT_TRUE(b != NULL);
    TEST_ASSERT_TRUE(c != NULL);
    TEST_ASSERT_NEAR(5.0, sdr_cpx_abs(z), 1e-6);
    
    for (int i = 0; i < 4; i++) {
        a[i][0] = (float)(i + 1);
        a[i][1] = (float)(-i);
        b[i][0] = 2.0f;
        b[i][1] = 1.0f;
    }
    sdr_cpx_mul(a, b, 4, 0.5f, c);
    TEST_ASSERT_NEAR(1.0, c[0][0], 1e-6);
    TEST_ASSERT_NEAR(0.5, c[0][1], 1e-6);
    TEST_ASSERT_NEAR(2.5, c[1][0], 1e-6);
    TEST_ASSERT_NEAR(0.0, c[1][1], 1e-6);
    
    memset(a, 0, sizeof(sdr_cpx_t) * 4);
    a[0][0] = 1.0f;
    TEST_ASSERT_EQ_INT(1, sdr_cpx_fft(a, 4, SDR_FFT_FORWARD, b));
    for (int i = 0; i < 4; i++) {
        TEST_ASSERT_TRUE(isfinite(b[i][0]));
        TEST_ASSERT_TRUE(isfinite(b[i][1]));
    }
    TEST_ASSERT_EQ_INT(0, sdr_cpx_fft(a, 4, -1, b));
    
    sdr_cpx_free(a);
    sdr_cpx_free(b);
    sdr_cpx_free(c);
    sdr_cpx_free(NULL);
}

// sdr_buff_new(), sdr_buff_free(), sdr_read_data() ----------------------------
static void test_sdr_buff_read_api(void)
{
    const int8_t raw_i[] = {-3, 4, 7};
    const int8_t raw_iq[] = {1, 2, 3, -4};
    sdr_buff_t *buff;
    
    buff = sdr_buff_new(8, 2);
    TEST_ASSERT_TRUE(buff != NULL);
    TEST_ASSERT_EQ_INT(8, buff->N);
    TEST_ASSERT_EQ_INT(2, buff->IQ);
    sdr_buff_free(buff);
    sdr_buff_free(NULL);
    
    write_file(TMP_DATA, raw_i, sizeof(raw_i));
    buff = sdr_read_data(TMP_DATA, 1.0, 1, 0.0, 0.0);
    TEST_ASSERT_TRUE(buff != NULL);
    TEST_ASSERT_EQ_INT(3, buff->N);
    TEST_ASSERT_EQ_INT(-3, SDR_CPX8_I(buff->data[0]));
    TEST_ASSERT_EQ_INT(0, SDR_CPX8_Q(buff->data[0]));
    sdr_buff_free(buff);
    
    write_file(TMP_DATA, raw_iq, sizeof(raw_iq));
    buff = sdr_read_data(TMP_DATA, 2.0, 2, 1.0, 0.0);
    TEST_ASSERT_TRUE(buff != NULL);
    TEST_ASSERT_EQ_INT(2, buff->N);
    TEST_ASSERT_EQ_INT(1, SDR_CPX8_I(buff->data[0]));
    TEST_ASSERT_EQ_INT(-2, SDR_CPX8_Q(buff->data[0]));
    TEST_ASSERT_EQ_INT(3, SDR_CPX8_I(buff->data[1]));
    TEST_ASSERT_EQ_INT(4, SDR_CPX8_Q(buff->data[1]));
    sdr_buff_free(buff);
    
    TEST_ASSERT_TRUE(sdr_read_data(TMP_DATA, 1.0, 1, 1.0, 99.0) == NULL);
}

// sdr_tag_write(), sdr_tag_read() --------------------------------------------
static void test_sdr_tag_api(void)
{
    double ep[6] = {2026, 6, 4, 1, 2, 3.0};
    gtime_t time = epoch2time(ep), time2 = {0};
    double fo[SDR_MAX_RFCH] = {1575.42e6, 1227.60e6};
    double fo2[SDR_MAX_RFCH] = {0};
    int IQ[SDR_MAX_RFCH] = {2, 1};
    int IQ2[SDR_MAX_RFCH] = {0};
    int bits[SDR_MAX_RFCH] = {4, 2};
    int bits2[SDR_MAX_RFCH] = {0};
    char prog[32] = "";
    int fmt = 0, nch = 0;
    double fs = 0.0;
    
    TEST_ASSERT_EQ_INT(1, sdr_tag_write(TMP_TAG, "utest", time, SDR_FMT_RAW8,
        0, 24e6, fo, IQ, bits));
    TEST_ASSERT_EQ_INT(1, sdr_tag_read(TMP_TAG, prog, &time2, &fmt, &nch, &fs,
        fo2, IQ2, bits2));
    TEST_ASSERT_TRUE(!strcmp("utest", prog));
    TEST_ASSERT_EQ_INT(SDR_FMT_RAW8, fmt);
    TEST_ASSERT_EQ_INT(2, nch); // as defined by the format
    TEST_ASSERT_NEAR(24e6, fs, 1.0);
    TEST_ASSERT_NEAR(1575.42e6, fo2[0], 1.0);
    TEST_ASSERT_EQ_INT(2, IQ2[0]);
    TEST_ASSERT_EQ_INT(4, bits2[0]);
    TEST_ASSERT_EQ_INT(0, IQ2[2]);
    
    // CH planar IF data of a single CH format
    TEST_ASSERT_EQ_INT(1, sdr_tag_write(TMP_TAG, "utest", time, SDR_FMT_CS16,
        4, 24e6, fo, IQ, bits));
    TEST_ASSERT_EQ_INT(1, sdr_tag_read(TMP_TAG, NULL, NULL, &fmt, &nch, &fs,
        fo2, IQ2, bits2));
    TEST_ASSERT_EQ_INT(SDR_FMT_CS16, fmt);
    TEST_ASSERT_EQ_INT(4, nch);
    
    // nch is optional for backward compatibility with old tag files
    write_file(TMP_BAD_TAG ".tag", "FMT = CS16\n", 11);
    nch = 0;
    TEST_ASSERT_EQ_INT(1, sdr_tag_read(TMP_BAD_TAG, NULL, NULL, &fmt, &nch,
        &fs, fo2, IQ2, bits2));
    TEST_ASSERT_EQ_INT(1, nch);
    
    // a planar IF data of a different processing cycle is unusable
    write_file(TMP_BAD_TAG ".tag", "FMT = CS16\nNCH = 4\nT_CYC = 0.002\n", 33);
    TEST_ASSERT_EQ_INT(-1, sdr_tag_read(TMP_BAD_TAG, NULL, NULL, &fmt, &nch,
        &fs, fo2, IQ2, bits2));
    
    TEST_ASSERT_EQ_INT(0, sdr_tag_write(TMP_TAG, "utest", time, 0, 0, fs, fo,
        IQ, bits));
    
    write_file(TMP_BAD_TAG ".tag", "FMT = -\n", 8);
    TEST_ASSERT_EQ_INT(0, sdr_tag_read(TMP_BAD_TAG, NULL, NULL, &fmt, &nch,
        &fs, fo2, IQ2, bits2));
}

// sdr_mix_carr() --------------------------------------------------------------
static void test_sdr_mix_carr_api(void)
{
    sdr_buff_t *buff = sdr_buff_new(4, 2);
    sdr_cpx16_t IQ[4];
    
    buff->data[0] = pack_cpx8(1, -2);
    buff->data[1] = pack_cpx8(2, 1);
    buff->data[2] = pack_cpx8(-1, 3);
    buff->data[3] = pack_cpx8(0, -1);
    
    sdr_mix_carr(buff, 0, 2, 4.0, 0.0, 0.0, IQ);
    TEST_ASSERT_EQ_INT(11, IQ[0].I);
    TEST_ASSERT_EQ_INT(-22, IQ[0].Q);
    TEST_ASSERT_EQ_INT(22, IQ[1].I);
    TEST_ASSERT_EQ_INT(11, IQ[1].Q);
    
    sdr_mix_carr(buff, 3, 3, 4.0, 0.0, 0.0, IQ);
    TEST_ASSERT_EQ_INT(0, IQ[0].I);
    TEST_ASSERT_EQ_INT(-11, IQ[0].Q);
    TEST_ASSERT_EQ_INT(11, IQ[1].I);
    TEST_ASSERT_EQ_INT(-22, IQ[1].Q);
    sdr_buff_free(buff);
}

// reference carrier mixing by the LUT formula ---------------------------------
static void ref_mix_carr(const sdr_buff_t *buff, int ix, int N, double fs,
    double fc, double phi, sdr_cpx16_t *IQ)
{
    double scale = (double)(1 << 24) * 256;
    uint32_t p = (uint32_t)((phi - floor(phi)) * scale);
    uint32_t s = (uint32_t)(int)(fc / fs * scale);

    for (int i = 0; i < N; i++, p += s) {
        int k = p >> 24, I = SDR_CPX8_I(buff->data[ix+i]);
        int Q = SDR_CPX8_Q(buff->data[ix+i]);
        int cI = (int)floor(cos(-2.0 * PI * k / 256) / SDR_CSCALE + 0.5);
        int cQ = (int)floor(sin(-2.0 * PI * k / 256) / SDR_CSCALE + 0.5);
        IQ[i].I = (int8_t)(I * cI - Q * cQ);
        IQ[i].Q = (int8_t)(I * cQ + Q * cI);
    }
}

// sdr_mix_carr() vs reference for all lengths including SIMD tails ------------
static void test_sdr_mix_carr_equiv(void)
{
    const int NB = 1024;
    sdr_buff_t *buff = sdr_buff_new(NB, 2);
    sdr_cpx16_t IQ[256], ref[256];

    for (int i = 0; i < NB; i++) {
        buff->data[i] = (sdr_cpx8_t)((i * 37 + 11) & 0xFF);
    }
    for (int N = 1; N <= 160; N++) {
        int ix = (N * 7) % 512;
        double fc = -4200.0 + N * 123.4, phi = 0.0137 * N;
        ref_mix_carr(buff, ix, N, 24e6, fc, phi, ref);
        sdr_mix_carr(buff, ix, N, 24e6, fc, phi, IQ);
        TEST_ASSERT_TRUE(!memcmp(IQ, ref, sizeof(sdr_cpx16_t) * N));
    }
    sdr_buff_free(buff);
}

// sdr_corr_std(), sdr_corr_std_cpx(), sdr_corr_fft(), sdr_corr_fft_cpx(),
// sdr_search_code() -----------------------------------------------------------
static void test_sdr_corr_api(void)
{
    const int N = 4, npos = 3;
    int8_t code[4 * SDR_N_CODES];
    sdr_cpx_t corr[4], C[2], code_fft[4];
    sdr_cpx_t cbuff[4], corr_fft[4];
    double pos[3] = {0.0, 1.0, -1.0};
    float code_real[4] = {1, 1, 1, 1};
    float P[4] = {1, 1, 1, 1};
    float fds[1] = {0.0f};
    sdr_buff_t *buff = sdr_buff_new(4, 2);

    for (int i = 0; i < N; i++) {
        cbuff[i][0] = (float)(i + 1);
        cbuff[i][1] = (float)(-i);
        buff->data[i] = pack_cpx8(i + 1, -i);
        code_fft[i][0] = code_fft[i][1] = 0.0f;
    }
    int32_t code_sum[(4 + 1) * SDR_N_CODES] = {0};
    for (int k = 0; k < SDR_N_CODES; k++) {
        for (int i = 0; i < N; i++) {
            code[k*N+i] = 1;
            code_sum[k*(N+1)+i+1] = code_sum[k*(N+1)+i] + 1;
        }
    }

    sdr_corr_std(buff, 0, N, 4.0, 0.0, 0.0, code, code_sum, NULL, NULL, 1,
        0.0, pos, npos, 0, corr, C);
    TEST_ASSERT_TRUE(isfinite(corr[0][0]));
    TEST_ASSERT_TRUE(isfinite(corr[0][1]));

    sdr_corr_std_cpx(cbuff, N, 0, N, 4.0, 0.0, 0.0, code_real, pos, npos,
        corr);
    TEST_ASSERT_TRUE(isfinite(corr[0][0]));
    
    sdr_corr_fft(buff, 0, N, 4.0, 0.0, 0.0, code_fft, corr_fft);
    for (int i = 0; i < N; i++) {
        TEST_ASSERT_NEAR(0.0, corr_fft[i][0], 1e-6);
        TEST_ASSERT_NEAR(0.0, corr_fft[i][1], 1e-6);
    }
    
    sdr_corr_fft_cpx(cbuff, N, 0, N, 4.0, 0.0, 0.0, code_fft, corr_fft);
    TEST_ASSERT_NEAR(0.0, corr_fft[0][0], 1e-6);
    
    sdr_search_code(code_fft, 1.0, buff, 0, N, 4.0, 0.0, fds, 1, P);
    for (int i = 0; i < N; i++) {
        TEST_ASSERT_TRUE(isfinite(P[i]));
        TEST_ASSERT_NEAR(1.0, P[i], 1e-6);
    }
    sdr_buff_free(buff);
}

// generate prefix sums of code bank ---------------------------------------------
static int32_t *gen_code_sum(const int8_t *code, int N)
{
    int32_t *code_sum = (int32_t *)sdr_malloc(sizeof(int32_t) * (N + 1) *
        SDR_N_CODES);
    for (int k = 0; k < SDR_N_CODES; k++) {
        int32_t *cs = code_sum + k * (N + 1);
        for (int i = 0; i < N; i++) {
            cs[i+1] = cs[i] + code[k * N + i];
        }
    }
    return code_sum;
}

// reference standard correlator (mix carrier + scalar correlations) -----------
static void ref_corr_std(const sdr_buff_t *buff, int ix, int N, double fs,
    double fc, double phi, const int8_t *code, const int8_t *code_Q,
    int scale, double coff, const double *pos, int n, int pol,
    sdr_cpx_t *corr, sdr_cpx_t *C)
{
    sdr_cpx16_t *IQ = (sdr_cpx16_t *)sdr_malloc(sizeof(sdr_cpx16_t) * N);
    sdr_cpx_t corr1[SDR_MAX_CORR], corr2[SDR_MAX_CORR];
    float dot_EPL = 0.0, sign, cscale = SDR_CSCALE / scale;

    sdr_mix_carr(buff, ix, N, fs, fc, phi, IQ);
    for (int i = 0; i < n; i++) {
        double p = coff + pos[i];
        int j = (int)floor(p), k = (int)((p - j) * SDR_N_CODES);
        if (j < 0) j += N; else if (j >= N) j -= N;
        const int8_t *cI = code + k * N;
        const int8_t *cQ = code_Q ? code_Q + k * N : NULL;
        int32_t s1I = 0, s1Q = 0, s2I = 0, s2Q = 0;
        for (int s = 0; s < j; s++) {
            s1I += IQ[s].I * cI[N-j+s] + (cQ ? IQ[s].Q * cQ[N-j+s] : 0);
            s1Q += IQ[s].Q * cI[N-j+s] - (cQ ? IQ[s].I * cQ[N-j+s] : 0);
        }
        for (int s = j; s < N; s++) {
            s2I += IQ[s].I * cI[s-j] + (cQ ? IQ[s].Q * cQ[s-j] : 0);
            s2Q += IQ[s].Q * cI[s-j] - (cQ ? IQ[s].I * cQ[s-j] : 0);
        }
        corr1[i][0] = s1I * cscale;
        corr1[i][1] = s1Q * cscale;
        corr2[i][0] = s2I * cscale;
        corr2[i][1] = s2Q * cscale;
    }
    for (int i = 0; i < 3; i++) {
        dot_EPL += corr1[i][0] * corr2[i][0] + corr1[i][1] * corr2[i][1];
    }
    sign = pol ? (pol > 0 ? 1.0f : -1.0f) : (dot_EPL < 0.0f ? -1.0f : 1.0f);

    for (int i = 0; i < n; i++) {
        corr[i][0] = (corr1[i][0] + sign * corr2[i][0]) / N;
        corr[i][1] = (corr1[i][1] + sign * corr2[i][1]) / N;
    }
    for (int i = 0; i < 2; i++) {
        C[0][i] = corr1[0][i];
        C[1][i] = corr2[0][i];
    }
    sdr_free(IQ);
}

// sdr_corr_std() vs reference implementation ----------------------------------
static void test_sdr_corr_std_equiv(void)
{
    const int N = 9000, npos = 4;
    sdr_buff_t *buff = sdr_buff_new(12000, 2);
    int8_t *code = (int8_t *)sdr_malloc(sizeof(int8_t) * N * SDR_N_CODES);
    sdr_cpx_t corr1[4], corr2[4], C1[2], C2[2];
    double pos[4] = {0.0, -3.3, 3.3, 7.7};
    double fs = 12e6, fc = 4250.0, phi = 0.678, coff = 2.5;
    
    for (int i = 0; i < buff->N; i++) {
        buff->data[i] = pack_cpx8(i % 7 - 3, 3 - i % 5);
    }
    for (int i = 0; i < N * SDR_N_CODES; i++) {
        code[i] = (int8_t)(i % 5 == 0 ? 0 : (i % 2 ? -1 : 1));
    }
    int32_t *code_sum = gen_code_sum(code, N);

    // without IF buffer wrap-around
    ref_corr_std(buff, 100, N, fs, fc, phi, code, NULL, 1, coff, pos, npos, 0,
        corr1, C1);
    sdr_corr_std(buff, 100, N, fs, fc, phi, code, code_sum, NULL, NULL, 1,
        coff, pos, npos, 0, corr2, C2);
    for (int i = 0; i < npos; i++) {
        TEST_ASSERT_NEAR(corr1[i][0], corr2[i][0], 1e-9);
        TEST_ASSERT_NEAR(corr1[i][1], corr2[i][1], 1e-9);
    }
    for (int i = 0; i < 2; i++) {
        TEST_ASSERT_NEAR(C1[0][i], C2[0][i], 1e-9);
        TEST_ASSERT_NEAR(C1[1][i], C2[1][i], 1e-9);
    }
    // across IF buffer wrap-around (phase re-quantized at the boundary)
    ref_corr_std(buff, 8000, N, fs, fc, phi, code, NULL, 1, coff, pos, npos,
        0, corr1, C1);
    sdr_corr_std(buff, 8000, N, fs, fc, phi, code, code_sum, NULL, NULL, 1,
        coff, pos, npos, 0, corr2, C2);
    for (int i = 0; i < npos; i++) {
        TEST_ASSERT_NEAR(corr1[i][0], corr2[i][0], 1e-3);
        TEST_ASSERT_NEAR(corr1[i][1], corr2[i][1], 1e-3);
    }
    sdr_free(code_sum);

    // int8 multi-level code values (CBOC levels scaled by SDR_CBOC_SCALE)
    for (int i = 0; i < N * SDR_N_CODES; i++) {
        int8_t level = (int8_t)(i % 3 == 0 ? 40 : 21);
        code[i] = (int8_t)(i % 2 ? -level : level);
    }
    code_sum = gen_code_sum(code, N);
    ref_corr_std(buff, 100, N, fs, fc, phi, code, NULL, SDR_CBOC_SCALE, coff,
        pos, npos, 0, corr1, C1);
    sdr_corr_std(buff, 100, N, fs, fc, phi, code, code_sum, NULL, NULL,
        SDR_CBOC_SCALE, coff, pos, npos, 0, corr2, C2);
    for (int i = 0; i < npos; i++) {
        TEST_ASSERT_NEAR(corr1[i][0], corr2[i][0], 1e-9);
        TEST_ASSERT_NEAR(corr1[i][1], corr2[i][1], 1e-9);
    }
    for (int i = 0; i < 2; i++) {
        TEST_ASSERT_NEAR(C1[0][i], C2[0][i], 1e-9);
        TEST_ASSERT_NEAR(C1[1][i], C2[1][i], 1e-9);
    }
    sdr_free(code_sum);
    sdr_free(code);
    sdr_buff_free(buff);
}

// complex code correlation in one sdr_corr_std() call vs reference ------------
static void test_sdr_corr_std_cpx_code_equiv(void)
{
    const int N = 9000, npos = 4;
    sdr_buff_t *buff = sdr_buff_new(12000, 2);
    int8_t *code = (int8_t *)sdr_malloc(sizeof(int8_t) * N * SDR_N_CODES);
    int8_t *code_Q = (int8_t *)sdr_malloc(sizeof(int8_t) * N * SDR_N_CODES);
    sdr_cpx_t corr1[4], corr2[4], C1[2], C2[2];
    double pos[4] = {0.0, -3.3, 3.3, 7.7};
    double fs = 12e6, fc = 4250.0, phi = 0.678, coff = 2.5;

    for (int i = 0; i < buff->N; i++) {
        buff->data[i] = pack_cpx8(i % 7 - 3, 3 - i % 5);
    }
    // AltBOC-like complex code levels
    for (int k = 0; k < SDR_N_CODES; k++) {
        for (int i = 0; i < N; i++) {
            code[k*N+i] = (int8_t)((i * 7 + k * 3) % 109 - 54);
            code_Q[k*N+i] = (int8_t)((i * 11 + k * 5) % 109 - 54);
        }
    }
    int32_t *code_sum = gen_code_sum(code, N);
    int32_t *code_sum_Q = gen_code_sum(code_Q, N);

    for (int pol = -1; pol <= 1; pol++) { // int32 butterfly is bit-exact
        ref_corr_std(buff, 100, N, fs, fc, phi, code, code_Q,
            SDR_ALTBOC_SCALE, coff, pos, npos, pol, corr1, C1);
        sdr_corr_std(buff, 100, N, fs, fc, phi, code, code_sum, code_Q,
            code_sum_Q, SDR_ALTBOC_SCALE, coff, pos, npos, pol, corr2, C2);
        for (int i = 0; i < npos; i++) {
            TEST_ASSERT_NEAR(corr1[i][0], corr2[i][0], 1e-9);
            TEST_ASSERT_NEAR(corr1[i][1], corr2[i][1], 1e-9);
        }
        for (int i = 0; i < 2; i++) {
            TEST_ASSERT_NEAR(C1[0][i], C2[0][i], 1e-9);
            TEST_ASSERT_NEAR(C1[1][i], C2[1][i], 1e-9);
        }
    }
    sdr_free(code_sum_Q);
    sdr_free(code_sum);
    sdr_free(code_Q);
    sdr_free(code);
    sdr_buff_free(buff);
}

// pre-combined E5ABQ replica (1 call) == 2 sideband correlations combined -----
static void test_sdr_corr_std2_precombined(void)
{
    const int N = 9000, npos = 4, NC = N * SDR_N_CODES;
    sdr_buff_t *buff = sdr_buff_new(12000, 2);
    int8_t *aI = (int8_t *)sdr_malloc(NC), *aQ = (int8_t *)sdr_malloc(NC);
    int8_t *bI = (int8_t *)sdr_malloc(NC), *bQ = (int8_t *)sdr_malloc(NC);
    int8_t *pI = (int8_t *)sdr_malloc(NC), *pQ = (int8_t *)sdr_malloc(NC);
    int8_t *mI = (int8_t *)sdr_malloc(NC), *mQ = (int8_t *)sdr_malloc(NC);
    sdr_cpx_t Ca[4], Cb[4], C1a[2], C1b[2], corr[4], C[2];
    double pos[4] = {0.0, -3.3, 3.3, 7.7};
    double fs = 12e6, fc = 4250.0, phi = 0.678, coff = 2.5;

    for (int i = 0; i < buff->N; i++) {
        buff->data[i] = pack_cpx8(i % 7 - 3, 3 - i % 5);
    }
    for (int i = 0; i < NC; i++) { // AltBOC-like stairs (|a|,|b| <= 32)
        aI[i] = (int8_t)((i % 4) * 21 - 32);
        aQ[i] = (int8_t)((i % 5) * 16 - 32);
        bI[i] = (int8_t)((i % 3) * 32 - 32);
        bQ[i] = (int8_t)((i % 7) * 10 - 30);
        pI[i] = (int8_t)(aI[i] + bI[i]);
        pQ[i] = (int8_t)(aQ[i] + bQ[i]);
        mI[i] = (int8_t)(aI[i] - bI[i]);
        mQ[i] = (int8_t)(aQ[i] - bQ[i]);
    }
    int32_t *sAI = gen_code_sum(aI, N), *sAQ = gen_code_sum(aQ, N);
    int32_t *sBI = gen_code_sum(bI, N), *sBQ = gen_code_sum(bQ, N);
    int32_t *sPI = gen_code_sum(pI, N), *sPQ = gen_code_sum(pQ, N);
    int32_t *sMI = gen_code_sum(mI, N), *sMQ = gen_code_sum(mQ, N);

    for (int c = 0; c < 16; c++) { // all sec-code chip pair combinations
        int sa1 = (c & 1) ? 1 : -1, sa2 = (c & 2) ? 1 : -1;
        int sb1 = (c & 4) ? 1 : -1, sb2 = (c & 8) ? 1 : -1;
        for (int pol = -1; pol <= 1; pol += 2) {
            int k1 = pol * sa1 * sb1, k2 = pol * sa2 * sb2;

            // reference: correlate the sidebands separately and combine
            sdr_corr_std(buff, 100, N, fs, fc, phi, aI, sAI, aQ, sAQ,
                SDR_ALTBOC_SCALE, coff, pos, npos, sa1 * sa2, Ca, C1a);
            sdr_corr_std(buff, 100, N, fs, fc, phi, bI, sBI, bQ, sBQ,
                SDR_ALTBOC_SCALE, coff, pos, npos, sb1 * sb2, Cb, C1b);

            // one correlation with the pre-combined replica (a+b or a-b)
            sdr_corr_std2(buff, 100, N, fs, fc, phi,
                k1 > 0 ? pI : mI, k1 > 0 ? sPI : sMI,
                k1 > 0 ? pQ : mQ, k1 > 0 ? sPQ : sMQ,
                k2 > 0 ? pI : mI, k2 > 0 ? sPI : sMI,
                k2 > 0 ? pQ : mQ, k2 > 0 ? sPQ : sMQ,
                SDR_ALTBOC_SCALE * 2, coff, pos, npos, sa1 * sa2, corr, C);

            for (int i = 0; i < npos; i++) {
                TEST_ASSERT_NEAR((Ca[i][0] + k1 * Cb[i][0]) * 0.5f,
                    corr[i][0], 1e-5);
                TEST_ASSERT_NEAR((Ca[i][1] + k1 * Cb[i][1]) * 0.5f,
                    corr[i][1], 1e-5);
            }
            for (int i = 0; i < 2; i++) { // C is unnormalized (~N x corr)
                TEST_ASSERT_NEAR((C1a[0][i] + k1 * C1b[0][i]) * 0.5f,
                    C[0][i], 1e-2);
                TEST_ASSERT_NEAR((C1a[1][i] + k2 * C1b[1][i]) * 0.5f,
                    C[1][i], 1e-2);
            }
        }
    }
    sdr_free(sAI); sdr_free(sAQ); sdr_free(sBI); sdr_free(sBQ);
    sdr_free(sPI); sdr_free(sPQ); sdr_free(sMI); sdr_free(sMQ);
    sdr_free(aI); sdr_free(aQ); sdr_free(bI); sdr_free(bQ);
    sdr_free(pI); sdr_free(pQ); sdr_free(mI); sdr_free(mQ);
    sdr_buff_free(buff);
}

// sdr_corr_max(), sdr_fine_dop(), sdr_shift_freq(), sdr_dop_bins() ------------
static void test_sdr_search_helper_api(void)
{
    float P[12] = {1, 1, 1, 1, 1, 1, 4, 1, 1, 1, 1, 1};
    float P0[4] = {0};
    float fds[3] = {-500.0f, 0.0f, 500.0f};
    int ix[2] = {-1, -1};
    int len_fds = 0;
    float *bins;
    
    TEST_ASSERT_TRUE(sdr_corr_max(P, 4, 4, 3, 0.001, ix) > 0.0f);
    TEST_ASSERT_EQ_INT(1, ix[0]);
    TEST_ASSERT_EQ_INT(2, ix[1]);
    TEST_ASSERT_NEAR(0.0, sdr_fine_dop(P, 4, fds, 3, ix), 1e-6);
    ix[0] = 0;
    ix[1] = 0;
    TEST_ASSERT_NEAR(-500.0, sdr_fine_dop(P, 4, fds, 3, ix), 1e-6);
    TEST_ASSERT_NEAR(0.0, sdr_corr_max(P0, 4, 4, 1, 0.001, ix), 1e-6);
    
    TEST_ASSERT_NEAR(1.125e6, sdr_shift_freq("G1CA", 2, 0.0), 1e-6);
    TEST_ASSERT_NEAR(0.875e6, sdr_shift_freq("G2CA", 2, 0.0), 1e-6);
    TEST_ASSERT_NEAR(10.0, sdr_shift_freq("L1CA", 2, 10.0), 1e-12);
    
    bins = sdr_dop_bins(0.001, 0.0f, 1000.0f, &len_fds);
    TEST_ASSERT_TRUE(bins != NULL);
    TEST_ASSERT_EQ_INT(5, len_fds);
    TEST_ASSERT_NEAR(-1000.0, bins[0], 1e-6);
    TEST_ASSERT_NEAR(0.0, bins[2], 1e-6);
    TEST_ASSERT_NEAR(1000.0, bins[4], 1e-6);
    sdr_free(bins);
}

// sdr_psd_cpx() ---------------------------------------------------------------
static void test_sdr_psd_api(void)
{
    sdr_cpx_t buff[16];
    float psd_i[4], psd_iq[8];
    
    for (int i = 0; i < 16; i++) {
        buff[i][0] = (i & 1) ? 1.0f : -1.0f;
        buff[i][1] = (i & 2) ? 1.0f : -1.0f;
    }
    sdr_psd_cpx(buff, 16, 8, 8.0, 1, psd_i);
    for (int i = 0; i < 4; i++) {
        TEST_ASSERT_TRUE(isfinite(psd_i[i]) || isinf(psd_i[i]));
    }
    sdr_psd_cpx(buff, 16, 8, 8.0, 2, psd_iq);
    for (int i = 0; i < 8; i++) {
        TEST_ASSERT_TRUE(isfinite(psd_iq[i]) || isinf(psd_iq[i]));
    }
}

// sdr_str_open(), sdr_str_write(), sdr_str_close() ----------------------------
static void test_sdr_stream_api(void)
{
    stream_t *str;
    uint8_t msg[] = "abc";
    
    TEST_ASSERT_TRUE(sdr_str_open("") == NULL);
    TEST_ASSERT_EQ_INT(0, sdr_str_write(NULL, msg, 3));
    sdr_str_close(NULL);
    
    str = sdr_str_open(TMP_STREAM);
    TEST_ASSERT_TRUE(str != NULL);
    TEST_ASSERT_EQ_INT(3, sdr_str_write(str, msg, 3));
    sdr_str_close(str);
    TEST_ASSERT_EQ_INT(3, (int)file_size(TMP_STREAM));
}

// sdr_log_open(), sdr_log_close(), sdr_log_level(), sdr_log_mask(), sdr_log(),
// sdr_get_log(), sdr_log_stat() ----------------------------------------------
static void test_sdr_log_api(void)
{
    int mask_off[10] = {0};
    int mask_on[10] = {1,1,1,1,1,1,1,1,1,1};
    char buff[256];
    
    sdr_log_close();
    TEST_ASSERT_EQ_INT(0, sdr_log_open(NULL));
    TEST_ASSERT_EQ_INT(0, sdr_log_open(""));
    TEST_ASSERT_EQ_INT(1, sdr_log_open(TMP_LOG));
    TEST_ASSERT_EQ_INT(0, sdr_log_open(TMP_LOG));
    TEST_ASSERT_TRUE(sdr_log_stat() >= 0);
    
    sdr_log_level(3);
    sdr_log_mask(mask_on, 10);
    sdr_log(3, "$LOG,unit,%d", 7);
    TEST_ASSERT_TRUE(sdr_get_log(buff, sizeof(buff)) > 0);
    TEST_ASSERT_TRUE(strstr(buff, "$LOG,unit,7") != NULL);
    TEST_ASSERT_EQ_INT(0, sdr_get_log(buff, sizeof(buff)));
    
    sdr_log_mask(mask_off, 10);
    sdr_log(3, "$LOG,masked");
    TEST_ASSERT_EQ_INT(0, sdr_get_log(buff, sizeof(buff)));
    sdr_log_mask(mask_on, 10);
    sdr_log_close();
}

// sdr_log_add_str(), sdr_log_rm_str() -----------------------------------------
static void test_sdr_log_str_api(void)
{
    stream_t *str1, *str2;
    char buff[256];
    
    sdr_log_add_str(NULL);
    sdr_log_rm_str(NULL);
    
    str1 = sdr_str_open(TMP_LOG);
    str2 = sdr_str_open(TMP_LOG2);
    TEST_ASSERT_TRUE(str1 != NULL && str2 != NULL);
    sdr_log_add_str(str1);
    sdr_log_add_str(str1); // duplicate registration ignored
    sdr_log_add_str(str2);
    TEST_ASSERT_TRUE(sdr_log_stat() >= 0);
    
    sdr_log_level(3);
    sdr_log(3, "$LOG,multi,%d", 5);
    TEST_ASSERT_TRUE(sdr_get_log(buff, sizeof(buff)) > 0);
    
    sdr_log_rm_str(str1);
    sdr_log_rm_str(str2);
    sdr_str_close(str1);
    sdr_str_close(str2);
    
    // both registered streams got the record
    TEST_ASSERT_TRUE(file_size(TMP_LOG) > 0);
    TEST_ASSERT_EQ_INT((int)file_size(TMP_LOG), (int)file_size(TMP_LOG2));
    
    // no streams registered: no output
    remove(TMP_LOG);
    remove(TMP_LOG2);
    sdr_log(3, "$LOG,dropped");
    TEST_ASSERT_TRUE(sdr_get_log(buff, sizeof(buff)) > 0);
}

// sdr_parse_nums(), sdr_add_buff() -------------------------------------------
static void test_sdr_parse_add_api(void)
{
    int prns[SDR_MAX_NPRN] = {0};
    int vals[3] = {1, 2, 3};
    int item = 4;
    
    TEST_ASSERT_EQ_INT(5, sdr_parse_nums("1,3-5,x,8", prns));
    TEST_ASSERT_EQ_INT(1, prns[0]);
    TEST_ASSERT_EQ_INT(3, prns[1]);
    TEST_ASSERT_EQ_INT(5, prns[3]);
    TEST_ASSERT_EQ_INT(8, prns[4]);
    TEST_ASSERT_EQ_INT(0, sdr_parse_nums("", prns));
    TEST_ASSERT_EQ_INT(0, sdr_parse_nums("5-3", prns));
    
    sdr_add_buff(vals, 3, &item, sizeof(item));
    TEST_ASSERT_EQ_INT(2, vals[0]);
    TEST_ASSERT_EQ_INT(3, vals[1]);
    TEST_ASSERT_EQ_INT(4, vals[2]);
    item = 9;
    sdr_add_buff(vals, 1, &item, sizeof(item));
    TEST_ASSERT_EQ_INT(9, vals[0]);
}

// sdr_pack_bits(), sdr_unpack_bits(), sdr_unpack_data(), sdr_xor_bits() -------
static void test_sdr_bit_api(void)
{
    uint8_t bits[] = {1, 0, 1, 1};
    uint8_t packed[2] = {0xFF, 0xFF};
    uint8_t unpacked[8] = {0};
    
    sdr_pack_bits(bits, 4, 2, packed);
    TEST_ASSERT_EQ_INT(0x2C, packed[0]);
    sdr_unpack_bits(packed, 6, unpacked);
    TEST_ASSERT_EQ_INT(0, unpacked[0]);
    TEST_ASSERT_EQ_INT(0, unpacked[1]);
    TEST_ASSERT_EQ_INT(1, unpacked[2]);
    TEST_ASSERT_EQ_INT(0, unpacked[3]);
    TEST_ASSERT_EQ_INT(1, unpacked[4]);
    TEST_ASSERT_EQ_INT(1, unpacked[5]);
    
    memset(unpacked, 0, sizeof(unpacked));
    sdr_unpack_data(0xA, 4, unpacked);
    TEST_ASSERT_EQ_INT(1, unpacked[0]);
    TEST_ASSERT_EQ_INT(0, unpacked[1]);
    TEST_ASSERT_EQ_INT(1, unpacked[2]);
    TEST_ASSERT_EQ_INT(0, unpacked[3]);
    
    TEST_ASSERT_EQ_INT(0, sdr_xor_bits(0x00000000u));
    TEST_ASSERT_EQ_INT(1, sdr_xor_bits(0x00000001u));
    TEST_ASSERT_EQ_INT(0, sdr_xor_bits(0x00000003u));
    TEST_ASSERT_EQ_INT(0, sdr_xor_bits(0xFFFFFFFFu));
}

// sdr_gen_fftw_wisdom() -------------------------------------------------------
static void test_sdr_fftw_wisdom_api(void)
{
    TEST_ASSERT_EQ_INT(1, sdr_gen_fftw_wisdom(TMP_WISDOM, 4));
}

// sdr_lpf_new(), sdr_lpf_free(), sdr_lpf_apply() ------------------------------
static void test_sdr_lpf_api(void)
{
    sdr_lpf_t *lpf;
    sdr_cpx8_t data[64];
    
    TEST_ASSERT_TRUE(sdr_lpf_new(0.0, 24e6) == NULL);
    TEST_ASSERT_TRUE(sdr_lpf_new(1e6, 0.0) == NULL);
    TEST_ASSERT_TRUE(sdr_lpf_new(12e6, 24e6) == NULL);
    sdr_lpf_free(NULL);
    
    lpf = sdr_lpf_new(2e6, 24e6);
    TEST_ASSERT_TRUE(lpf != NULL);
    sdr_lpf_apply(lpf, data, 0);
    for (int i = 0; i < 64; i++) {
        data[i] = pack_cpx8(3, -2);
    }
    sdr_lpf_apply(lpf, data, 64);
    TEST_ASSERT_TRUE(abs(SDR_CPX8_I(data[63]) - 3) <= 1);
    TEST_ASSERT_TRUE(abs(SDR_CPX8_Q(data[63]) + 2) <= 1);
    sdr_lpf_free(lpf);
    
    lpf = sdr_lpf_new(8e6, 24e6);
    TEST_ASSERT_TRUE(lpf != NULL);
    for (int i = 0; i < 64; i++) {
        data[i] = pack_cpx8(7, -7);
    }
    sdr_lpf_apply(lpf, data, 64);
    for (int i = 0; i < 64; i++) {
        TEST_ASSERT_TRUE(SDR_CPX8_I(data[i]) >= -7 && SDR_CPX8_I(data[i]) <= 7);
        TEST_ASSERT_TRUE(SDR_CPX8_Q(data[i]) >= -7 && SDR_CPX8_Q(data[i]) <= 7);
    }
    sdr_lpf_free(lpf);
}

// sdr_lpf_apply() in one call vs. short chunks (SIMD path vs scalar path) -----
static void test_sdr_lpf_apply_equiv(void)
{
    const int N = 1100;
    sdr_cpx8_t data1[1100], data2[1100];
    sdr_lpf_t *lpf1 = sdr_lpf_new(3e6, 24e6), *lpf2 = sdr_lpf_new(3e6, 24e6);

    for (int i = 0; i < N; i++) {
        data1[i] = data2[i] = (sdr_cpx8_t)((i * 53 + 7) & 0xFF);
    }
    sdr_lpf_apply(lpf1, data1, N);
    for (int i = 0; i < N; i += 3) {
        sdr_lpf_apply(lpf2, data2 + i, N - i < 3 ? N - i : 3);
    }
    TEST_ASSERT_TRUE(!memcmp(data1, data2, N));
    sdr_lpf_free(lpf1);
    sdr_lpf_free(lpf2);
}

// main ------------------------------------------------------------------------
int main(void)
{
    cleanup_files();
    TEST_RUN(test_sdr_func_init_api);
    TEST_RUN(test_sdr_cpx_api);
    TEST_RUN(test_sdr_buff_read_api);
    TEST_RUN(test_sdr_tag_api);
    TEST_RUN(test_sdr_mix_carr_api);
    TEST_RUN(test_sdr_mix_carr_equiv);
    TEST_RUN(test_sdr_corr_api);
    TEST_RUN(test_sdr_corr_std_equiv);
    TEST_RUN(test_sdr_corr_std_cpx_code_equiv);
    TEST_RUN(test_sdr_corr_std2_precombined);
    TEST_RUN(test_sdr_search_helper_api);
    TEST_RUN(test_sdr_psd_api);
    TEST_RUN(test_sdr_stream_api);
    TEST_RUN(test_sdr_log_api);
    TEST_RUN(test_sdr_log_str_api);
    TEST_RUN(test_sdr_parse_add_api);
    TEST_RUN(test_sdr_bit_api);
    TEST_RUN(test_sdr_fftw_wisdom_api);
    TEST_RUN(test_sdr_lpf_api);
    TEST_RUN(test_sdr_lpf_apply_equiv);
    cleanup_files();
    return 0;
}
